/dts-v1/;

/* this file is copy from volcano.dts */
#include "volcano.dtsi"
#include "feature/keys/volcano-fpv6-switch-key.dtsi"
#include "feature/keys/volcano-fp6v-hall-key.dtsi"

/ {
	model = "Qualcomm Technologies, Inc. Volcano SoC";
	compatible = "qcom,volcano";
	qcom,board-id = <0 0>;
};

&chosen {
	framebuffer0: framebuffer@e3940000 {
		compatible = "simple-framebuffer";
		reg = <0x0 0xe3940000 0x0 (2484 * 1116 * 4)>;
		width = <1116>;
		height = <2484>;
		stride = <(1116 * 4)>;
		format = "a8r8g8b8";
		interconnects = <&mmss_noc MASTER_MDP QCOM_ICC_TAG_ALWAYS
					&mc_virt SLAVE_EBI1 QCOM_ICC_TAG_ALWAYS>;
		clocks = <&gcc GCC_DISP_HF_AXI_CLK>;
	};
};
